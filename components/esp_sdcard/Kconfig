## components/esp_sdcard/Kconfig
```kconfig
menu "SD card configuration"

config SDCARD_PIN_MISO
    int "MISO pin number"
    default 2

config SDCARD_PIN_MOSI
    int "MOSI pin number"
    default 15

config SDCARD_PIN_CLK
    int "CLK pin number"
    default 14

config SDCARD_PIN_CS
    int "CS pin number"
    default 13
endmenu
```

## main/Kconfig
```kconfig
menu "Video demo configuration"
    choice
        prompt "Video format"
        default ESP_VIDEO_RAW
        config ESP_VIDEO_RAW
            bool "RAW RGB565"
        config ESP_VIDEO_MJPG
            bool "MJPG"
    endchoice
endmenu
```
